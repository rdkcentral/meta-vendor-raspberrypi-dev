## conf/distro/include/repo-details.inc
```bitbake
#--------------------------------------------------------------------------------
#Description: Environment variables.
#---------------------------------------------------------------------------------
#

CMF_GIT_ROOT ?= "git://code.rdkcentral.com/r"
CMF_GIT_PROTOCOL ?= "https"
CMF_RDK_COMPONENTS_ROOT_GIT ?= "${CMF_GIT_ROOT}/rdk/components"
CMF_GIT_BRANCH ?= "rdk-next"
CMF_GIT_MASTER_BRANCH ?= "master"
CMF_GIT_SRC_URI_SUFFIX = "protocol=${CMF_GIT_PROTOCOL};nobranch=1"

CMF_GITHUB_ROOT ?= "git://github.com/rdkcentral"
CMF_GITHUB_MAIN_BRANCH ?= "main"
CMF_GITHUB_MASTER_BRANCH ?= "master"
CMF_GITHUB_STABLE2_BRANCH ?= "topic/rdke_mvp"

RDKE_GITHUB_BRANCH ?= "develop"
RDK_GENERIC_ROOT_GIT ?= "git://${RDK_GIT}/rdk/components/generic"

# Fix the build error; related to: meta-image-support/pull/136
PROJECT_BRANCH ?= "${RDKE_GITHUB_BRANCH}"
```

## conf/layer.conf
```bitbake
# We have a conf and classes directory, add to BBPATH
BBPATH .= ":${LAYERDIR}"

# We have recipes-* directories, add to BBFILES
BBFILES += "${LAYERDIR}/recipes-*/*/*.bb \
            ${LAYERDIR}/recipes-*/*/*.bbappend"

BBFILE_COLLECTIONS += "rdk-raspberrypi"
BBFILE_PATTERN_rdk-raspberrypi = "^${LAYERDIR}/"
BBFILE_PRIORITY_rdk-raspberrypi = "7"

LAYERDEPENDS_rdk-raspberrypi = "core"
LAYERSERIES_COMPAT_rdk-raspberrypi = "kirkstone"

# Layer directory for use in recipes and classes
RDKE_GPU_LAYER_CONFIG_JSON = "${LAYERDIR}/conf/machine/include/rdke-gpu-layer-conf.json"
```

## conf/machine/include/vendor.inc
```bitbake
require conf/distro/include/repo-details.inc

include conf/include/rdke-vendor-bbmask.inc
include conf/include/vendor_pkg_versions.inc

#Enable esdk
DISTRO_FEATURES:append = " VENDOR"
DISTRO_FEATURES:append = " enable_esdk"

VENDOR_LAYER_EXTENSION = "${MACHINE}-vendor"
PACKAGE_EXTRA_ARCHS:append = " ${VENDOR_LAYER_EXTENSION}"

LAYER_EXTENSION = "-vendor"
VENDOR_OSS_REL_VER = "4.10.0"
VENDOR_OSS = "${@get_oss_arch(d)}${LAYER_EXTENSION}"
PACKAGE_EXTRA_ARCHS:append = "${@ '' if '${VENDOR_OSS}' == '${OSS_LAYER_ARCH}' else ' ${VENDOR_OSS}'}"
OPKG_ARCH_PRIORITY:${VENDOR_OSS} = "310"
STACK_LAYER_EXTENSION ?= "${VENDOR_OSS} ${VENDOR_LAYER_EXTENSION}"
EXCLUDE_IPK_FEEDS ?= "${VENDOR_OSS} ${VENDOR_LAYER_EXTENSION}"

LICENSE_FLAGS_ACCEPTED += "commercial_gst-fluendo-mpegdemux \
                            commercial_${MLPREFIX}gst-ffmpeg \
                            ${@bb.utils.contains('DISTRO_FEATURES', 'gstreamer1_18','commercial_${MLPREFIX}ffmpeg','commercial_${MLPREFIX}libav',d)} \
                            commercial_libomxil \
                            commercial_gst-openmax \
                            commercial_mpg123 \
                            commercial_${MLPREFIX}x264 \
                            commercial_gstreamer1.0-omx \
                            commercial_${MLPREFIX}gstreamer1.0-libav"

# Override introduced to mark components or features to be moved into OSS layer.
OVERRIDES .= ":rdkv-oss"

#Android raspberrypi Kernel version
KERNEL_ARPI_MAJOR_VERSION = "6"
```
